## src/mainboard/lenovo/w541/Kconfig
```kconfig
if BOARD_LENOVO_THINKPAD_W541

config BOARD_SPECIFIC_OPTIONS
	def_bool y
	select BOARD_ROMSIZE_KB_12288
	select CPU_INTEL_HASWELL
	select H8_HAS_PRIMARY_FN_KEYS
	select EC_LENOVO_H8
	select EC_LENOVO_PMH7
	select NO_UART_ON_SUPERIO
	select HAVE_ACPI_RESUME
	select HAVE_ACPI_TABLES
	select HAVE_OPTION_TABLE
	#select HAVE_CMOS_DEFAULT
	select MAINBOARD_HAS_LPC_TPM
	select MAINBOARD_HAS_TPM1
	select INTEL_GMA_HAVE_VBT
	select INTEL_INT15
	select MAINBOARD_HAS_LIBGFXINIT # FIXME: not working
	select NORTHBRIDGE_INTEL_HASWELL
	select SERIRQ_CONTINUOUS_MODE
	select SOUTHBRIDGE_INTEL_LYNXPOINT
	select SYSTEM_TYPE_LAPTOP
	select MAINBOARD_USES_IFD_GBE_REGION
	select H8_HAS_BAT_THRESHOLDS_IMPL

config MAINBOARD_DIR
	string
	default "lenovo/w541"

config MAINBOARD_PART_NUMBER
	string
	default "ThinkPad W541"

config VGA_BIOS_FILE
	string
	default "pci8086,0416.rom"

config VGA_BIOS_ID
	string
	default "8086,0416"

config USBDEBUG_HCD_INDEX # FIXME: check this
	int
	default 2

config DRIVER_LENOVO_SERIALS
	bool
	default n

config PS2K_EISAID
	default "LEN0071"

config PS2M_EISAID
	default "LEN004A"

config THINKPADEC_HKEY_EISAID
	default "LEN0068"

endif
```
