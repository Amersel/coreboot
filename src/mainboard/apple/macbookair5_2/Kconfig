## src/mainboard/apple/macbookair5_2/Kconfig
```kconfig
if BOARD_APPLE_MACBOOKAIR5_2

config BOARD_SPECIFIC_OPTIONS
	def_bool y
	select BOARD_ROMSIZE_KB_8192
	select EC_ACPI
	select GFX_GMA_PANEL_1_ON_EDP
	select HAVE_ACPI_RESUME
	select HAVE_ACPI_TABLES
	select HAVE_CMOS_DEFAULT
	select HAVE_OPTION_TABLE
	select HAVE_SPD_IN_CBFS
	select INTEL_INT15
	select MAINBOARD_HAS_LIBGFXINIT
	select NORTHBRIDGE_INTEL_SANDYBRIDGE
	select SERIRQ_CONTINUOUS_MODE
	select SOUTHBRIDGE_INTEL_C216
	select SYSTEM_TYPE_LAPTOP
	select USE_NATIVE_RAMINIT

config MAINBOARD_DIR
	string
	default apple/macbookair5_2

config MAINBOARD_PART_NUMBER
	string
	default "MacBookAir5,2"

config VGA_BIOS_ID
	string
	default "8086,0166"

config DRAM_RESET_GATE_GPIO
	int
	default 28

config MAX_CPUS
	int
	default 8

config USBDEBUG_HCD_INDEX
	int
	default 0

config MAINBOARD_SMBIOS_MANUFACTURER
	string
	default "Apple Inc."

endif
```

## src/mainboard/dell/optiplex_390/Kconfig
```kconfig
if BOARD_DELL_OPTIPLEX_390

config BOARD_SPECIFIC_OPTIONS
	def_bool y
	select BOARD_ROMSIZE_KB_4096
	select HAVE_ACPI_RESUME
	select HAVE_ACPI_TABLES
	select INTEL_INT15
	select MAINBOARD_HAS_LIBGFXINIT # FIXME: check this
	select NORTHBRIDGE_INTEL_SANDYBRIDGE
	select SERIRQ_CONTINUOUS_MODE
	select SOUTHBRIDGE_INTEL_BD82X6X
	select USE_NATIVE_RAMINIT

config MAINBOARD_DIR
	string
	default "dell/optiplex_390"

config MAINBOARD_PART_NUMBER
	string
	default "OptiPlex 390"

# config VGA_BIOS_ID
# 	string
# 	default "8086,0102"

config DRAM_RESET_GATE_GPIO # FIXME: check this
	int
	default 60

# config USBDEBUG_HCD_INDEX # FIXME: check this
# 	int
# 	default 2
endif
```

## src/mainboard/dell/optiplex_7010/Kconfig
```kconfig
if BOARD_DELL_OPTIPLEX_7010

config BOARD_SPECIFIC_OPTIONS
	def_bool y
	select BOARD_ROMSIZE_KB_12288
	select HAVE_ACPI_RESUME
	select HAVE_ACPI_TABLES
	select INTEL_INT15
	select MAINBOARD_HAS_LIBGFXINIT
	select NORTHBRIDGE_INTEL_SANDYBRIDGE
	select SERIRQ_CONTINUOUS_MODE
	select SOUTHBRIDGE_INTEL_C216
	select USE_NATIVE_RAMINIT
	select MAINBOARD_USES_IFD_GBE_REGION
	select MAINBOARD_HAS_LPC_TPM
	select MAINBOARD_HAS_TPM1
	select SUPERIO_SMSC_SCH5545
	select INTEL_GMA_HAVE_VBT
	select HAVE_OPTION_TABLE
	select HAVE_CMOS_DEFAULT

config MAINBOARD_DIR
	string
	default "dell/optiplex_7010"

config MAINBOARD_PART_NUMBER
	string
	default "OptiPlex 7010"

config INCLUDE_SMSC_SCH5545_EC_FW
	bool "Include SMSC SCH5545 EC firmware binary"
	default n
	help
	  This option allows to add the SMSC SCH5545 Environmental Controller
	  firmware binary. The firmware must be loaded after each power failure
	  in order to properly initialize the fan control, because EC loses its
	  configuration when power is cut off. Otherwise the fans will keep
	  running at full speed after power failure.

config SMSC_SCH5545_EC_FW_FILE
	string "File path to the SMSC SCH5545 EC firmware binary"
	depends on INCLUDE_SMSC_SCH5545_EC_FW


config DRAM_RESET_GATE_GPIO # FIXME: check this
	int
	default 60

endif
```

## src/mainboard/dell/optiplex_9020/Kconfig
```kconfig
## SPDX-License-Identifier: GPL-2.0-only

if BOARD_DELL_OPTIPLEX_7020 || BOARD_DELL_OPTIPLEX_9020

config BOARD_SPECIFIC_OPTIONS
	def_bool y
	select BOARD_ROMSIZE_KB_12288
	select HAVE_ACPI_RESUME
	select HAVE_ACPI_TABLES
	select HAVE_OPTION_TABLE
	select HAVE_CMOS_DEFAULT
	select INTEL_GMA_HAVE_VBT
	select INTEL_INT15
	select MAINBOARD_HAS_LIBGFXINIT
	select MAINBOARD_USES_IFD_GBE_REGION
	select NORTHBRIDGE_INTEL_HASWELL
	select SERIRQ_CONTINUOUS_MODE
	select SOUTHBRIDGE_INTEL_LYNXPOINT
	select SUPERIO_SMSC_SCH555x

config CBFS_SIZE
	hex
	default 0x600000

config MAINBOARD_DIR
	string
	default "dell/optiplex_9020"

endif

if BOARD_DELL_OPTIPLEX_7020

config MAINBOARD_PART_NUMBER
	string
	default "OptiPlex 7020"

endif

if BOARD_DELL_OPTIPLEX_9020

config MAINBOARD_PART_NUMBER
	string
	default "OptiPlex 9020"

endif
```

## src/mainboard/dell/optiplex_9020/Kconfig.name
```kconfig
## SPDX-License-Identifier: GPL-2.0-only

config BOARD_DELL_OPTIPLEX_7020
	bool "OptiPlex 7020 SFF/MT"
	help
	  The OptiPlex 7020 and 9020 boards are physically identical, these options
	  only change strings in the firmware.

config BOARD_DELL_OPTIPLEX_9020
	bool "OptiPlex 7020 USFF/SFF/MT"
	help
	  The OptiPlex 7020 and 9020 boards are physically identical, these options
	  only change strings in the firmware.
```

## src/mainboard/dell/optiplex_9030_aio/Kconfig
```kconfig
if BOARD_DELL_OPTIPLEX_9030_AIO

config BOARD_SPECIFIC_OPTIONS
	def_bool y
	select BOARD_ROMSIZE_KB_12288
	select HAVE_ACPI_RESUME
	select HAVE_ACPI_TABLES
	select MAINBOARD_HAS_LIBGFXINIT # FIXME: check this
	select NORTHBRIDGE_INTEL_HASWELL
	select SERIRQ_CONTINUOUS_MODE
	select SOUTHBRIDGE_INTEL_LYNXPOINT
	select MAINBOARD_USES_IFD_GBE_REGION
	select MAINBOARD_HAS_LIBGFXINIT
	select HAVE_ACPI_RESUME
	select HAVE_ACPI_TABLES
	select INTEL_GMA_HAVE_VBT
    select SUPERIO_SMSC_SCH555x
	

config MAINBOARD_DIR
	string
	default "dell/optiplex_9030_aio"

config MAINBOARD_PART_NUMBER
	string
	default "OptiPlex 9030 AIO"

config VGA_BIOS_ID
	string
	default "8086,0412"

config USBDEBUG_HCD_INDEX # FIXME: check this
	int
	default 2
endif
```

## src/mainboard/dell/optiplex_xe2/Kconfig
```kconfig
if BOARD_DELL_OPTIPLEX_XE2

config BOARD_SPECIFIC_OPTIONS
	def_bool y
	select BOARD_ROMSIZE_KB_12288
	select CPU_INTEL_HASWELL
	select HAVE_ACPI_RESUME
	select HAVE_ACPI_TABLES
	select INTEL_GMA_HAVE_VBT
	select INTEL_INT15
	select MAINBOARD_HAS_LIBGFXINIT # FIXME: check this
	select MAINBOARD_USES_IFD_GBE_REGION
	select NORTHBRIDGE_INTEL_HASWELL
	select SERIRQ_CONTINUOUS_MODE
	select SOUTHBRIDGE_INTEL_LYNXPOINT
	select SUPERIO_SMSC_SCH555x
	select TSC_MONOTONIC_TIMER
	select MAINBOARD_HAS_LPC_TPM
	select MAINBOARD_HAS_TPM1

#config GFX_GMA_CPU_VARIANT
#	string
#	default "Normal"

config CBFS_SIZE
	hex
	default 0x600000

config MAINBOARD_DIR
	string
	default "dell/optiplex_xe2"

config MAINBOARD_PART_NUMBER
	string
	default "OptiPlex XE2"

config VGA_BIOS_FILE
	string
	default "pci8086,0412.rom"

config VGA_BIOS_ID
	string
	default "8086,0412"

config MAINBOARD_PCI_SUBSYSTEM_DEVICE_ID
	hex
	default 0x5c1

config MAINBOARD_PCI_SUBSYSTEM_VENDOR_ID
	hex
	default 0x1028

#config MAX_CPUS
#	int
#	default 8

#config USBDEBUG_HCD_INDEX # FIXME: check this
#	int
#	default 2
endif
```

## src/mainboard/dell/precision_m4800/Kconfig
```kconfig
if BOARD_DELL_PRECISION_M4800

config BOARD_SPECIFIC_OPTIONS
	def_bool y
	select BOARD_ROMSIZE_KB_12288
	select EC_ACPI
	select HAVE_ACPI_RESUME
	select HAVE_ACPI_TABLES
	select HAVE_CMOS_DEFAULT
	select HAVE_OPTION_TABLE
	select INTEL_GMA_HAVE_VBT
	select MAINBOARD_HAS_LIBGFXINIT
	select MAINBOARD_HAS_TPM1
	select MAINBOARD_USES_IFD_GBE_REGION
	select MEMORY_MAPPED_TPM
	select NORTHBRIDGE_INTEL_HASWELL
	select SERIRQ_CONTINUOUS_MODE
	select SOUTHBRIDGE_INTEL_LYNXPOINT
	select SYSTEM_TYPE_LAPTOP
	select EC_DELL_MEC5035
	select GFX_GMA_PANEL_1_ON_EDP

config MAINBOARD_DIR
	string
	default "dell/precision_m4800"

config MAINBOARD_PART_NUMBER
	string
	default "Precision M4800"

config VGA_BIOS_ID
	string
	default "8086,0416"

config USBDEBUG_HCD_INDEX
	int
	default 2

endif
```
